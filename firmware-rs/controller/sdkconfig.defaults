## firmware-rs/controller/sdkconfig.defaults
```kconfig
# HTTP/WiFi
CONFIG_HTTPD_MAX_REQ_HDR_LEN=1024
CONFIG_ESP_WIFI_SSID=""
CONFIG_ESP_WIFI_PASSWORD=""

# Stack sizes (Rust needs more than C)
CONFIG_ESP_MAIN_TASK_STACK_SIZE=32768
CONFIG_PTHREAD_TASK_STACK_SIZE_DEFAULT=8192

# Keep default ESP-IDF partition table for predictable host-independent builds.
```

## firmware-rs/sensor/sdkconfig.defaults
```kconfig
# HTTP/WiFi
CONFIG_HTTPD_MAX_REQ_HDR_LEN=1024
CONFIG_ESP_WIFI_SSID=""
CONFIG_ESP_WIFI_PASSWORD=""

# Stack sizes (sensor is lighter than controller)
CONFIG_ESP_MAIN_TASK_STACK_SIZE=24576
CONFIG_PTHREAD_TASK_STACK_SIZE_DEFAULT=6144

# Flash size (4MB module)
CONFIG_ESPTOOLPY_FLASHSIZE_4MB=y

# Custom partition table with OTA support (1.5MB per slot for 4MB flash)
CONFIG_PARTITION_TABLE_CUSTOM=y
CONFIG_PARTITION_TABLE_CUSTOM_FILENAME="../../../../../../sensor/partitions.csv"
```
